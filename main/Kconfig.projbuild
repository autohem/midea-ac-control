## main/Kconfig.projbuild
```kconfig
menu "Example Configuration"

    config BLINK_GPIO
        int "Blink GPIO number"
        range 0 34
        default 5
        help
            GPIO number (IOxx) to blink on and off.

            Some GPIOs are used for other purposes (flash connections, etc.) and cannot be used to blink.

            GPIOs 35-39 are input-only so cannot be used as outputs.

endmenu

menu "Wifi Connection"
    config NETWORK_NAME
        string "network_name"
        help
            The network name desired to be connected
    config NETWORK_PASSWORD
        string "network_password"
        help
            Netork password
endmenu
```
